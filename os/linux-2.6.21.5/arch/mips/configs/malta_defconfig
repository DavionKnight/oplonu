## os/linux-2.6.21.5/arch/mips/mach-opulan/Kconfig
```kconfig
if OPULAN_SOC

choice
	prompt "Select Soc type"

config ARCH_OPTRANN
	bool "Optrann Soc"
	select OPULAN_SOC

config ARCH_ONU
	bool "ONU Soc"
	select OPULAN_SOC

config ARCH_ONU2
	bool "ONU2 Soc"
	select OPULAN_SOC

endchoice

source "arch/mips/mach-opulan/optrann/Kconfig"
source "arch/mips/mach-opulan/onu/Kconfig"
source "arch/mips/mach-opulan/onu2/Kconfig"

endif
```

## os/linux-2.6.21.5/arch/mips/mach-opulan/onu/Kconfig
```kconfig
if ARCH_ONU

choice
	prompt "Select target board type"

config ONU_F13_BOARD
	bool "Onu F13 board "
	select ARCH_ONU

config ONU_F13S_VOIP_BOARD
	bool "Onu F13s voip board "
	select ARCH_ONU

config ONU_F13P_VOIP_BOARD
	bool "Onu F13p voip board "
	select ARCH_ONU
	
config ONU_F13P_VOIP_PCM_WDT_BOARD
	bool "Onu F13p voip pcm watchdog board "
	select ARCH_ONU

config ONU_C13_BOARD
	bool "Onu C13 board "
	select ARCH_ONU

#config ONU_TONGWEI_BOARD
#	bool "Onu TongWei board "
#	select ARCH_ONU
	
config ONU_D2_F33_BOARD
	bool "Onu D2 (F33) board "
	select ARCH_ONU

config ONU_F23_BOARD
	bool "Onu F23 board "
	select ARCH_ONU

config ONU_F23_VOIP_BOARD
	bool "Onu F23 voip board "
	select ARCH_ONU

config ONU_F23S_VOIP_UT_BOARD
	bool "Onu F23 UT SPI flash voip board "
	select ARCH_ONU

config ONU_F23S_VOIP_BOARD
	bool "Onu F23 SPI flash voip board "
	select ARCH_ONU

config ONU_F23P_VOIP_BOARD
	bool "Onu F23 parallel flash voip board "
	select ARCH_ONU

config ONU_F33_VOIP_BOARD
    bool "Onu F33 voip board"
    select ARCH_ONU

config ONU_RESPIN_C13_BOARD
	bool "Onu respin  parallel flash board "
	select ARCH_ONU

config ONU_RESPIN_F23_BOARD
	bool "Onu respin  spi  flash board "
	select ARCH_ONU

config ONU_RESPIN_F23P_BOARD
	bool "Onu respin parallel flash board "
	select ARCH_ONU
	
config ONU_RESPIN_F13_BOARD
	bool "Onu respin spi  flash board "
	select ARCH_ONU	

config ONU_RESPIN_C13_SPI_BOARD
	bool "Onu respin c13 spi flash board "
	select ARCH_ONU

config ONU_RESPIN_C13_SPI_300M_BOARD
	bool "Onu respin c13 spi flash board "
	select ARCH_ONU
	
config ONU_RESPIN_RF400_BOARD
	bool "Onu respin rf400-gna spi flash board "
	select ARCH_ONU
	
config ONU_RESPIN_RF400P_BOARD
	bool "Onu respin rf400-gna parallel flash board "
	select ARCH_ONU

endchoice

endif
```

## os/linux-2.6.21.5/arch/mips/mach-opulan/onu2/Kconfig
```kconfig
if ARCH_ONU2

choice
	prompt "Select target board type"

config ONU2_EVA_BOARD
	bool "Onu2 EVA board "
	select ARCH_ONU2

config ONU2_TRANSWITCH_BOARD
	bool "Onu2  board for transwitch "
	select ARCH_ONU2

endchoice

endif
```

## os/linux-2.6.21.5/arch/mips/mach-opulan/optrann/Kconfig
```kconfig
if ARCH_OPTRANN

choice
	prompt "Select target board type"

config OPTRANN_EVA_BOARD
	bool "Optrann Evaluation board "
	select ARCH_OPTRANN

config OPTRANN_FIBER_FPGA
	bool "Optrann Fiber 10G FPGA  board "
	select ARCH_OPTRANN

endchoice

endif
```

## os/linux-2.6.21.5/drivers/net/ipmux_fe/Kconfig
```kconfig
config OPTRANN_FE_ETH
	tristate "Optrann FE network support"
	depends on ARCH_OPTRANN
	help
	  This is a driver for the Opulan Optrann FE network.


config ONU_FE_ETH
	tristate "Onu FE network support"
	depends on ARCH_ONU || ARCH_ONU2
	help
	  This is a driver for the Opulan Onu Soc FE network.

config ONU_FE_ETH_D2
	tristate "Onu FE network support for D2"
	depends on ARCH_ONU || ARCH_ONU2
	help
	  This is a driver for the Opulan Onu Soc FE network.

config ONU_FE_VOIP_F13_ETH
	tristate "Onu FE network support for F13"
	depends on ARCH_ONU
	help
	  This is a driver for the Opulan Onu F13 Soc FE network.

config ONU_FE_VOIP_F23_ETH
	tristate "Onu FE network support for F23"
	depends on ARCH_ONU
	help
	  This is a driver for the Opulan Onu F23 Soc FE network.

config ONU_FE_VOIP_F33_ETH
	tristate "Onu FE network support for F33"
	depends on ARCH_ONU
	help
	  This is a driver for the Opulan Onu F33 Soc FE network.	  

config ONU_FE_UT_F23_ETH
	tristate "Onu FE network support for UT F23"
	depends on ARCH_ONU
	help
	  This is a driver for the Opulan Onu F23 Soc FE network.
	  
config ONU_FE_RESPIN_F13_ETH
	tristate "Onu FE network support for onu_respin"
	depends on ARCH_ONU
	help
	  This is a driver for the Opulan onu_resin FE network.
	  
config ONU_FE_RESPIN_F23_ETH
	tristate "Onu FE network support for onu_respin"
	depends on ARCH_ONU
	help
	  This is a driver for the Opulan onu_resin FE network.	
	  
config ONU_FE_RESPIN_C13_ETH
	tristate "Onu FE network support for onu_respin"
	depends on ARCH_ONU
	help
	  This is a driver for the Opulan onu_resin FE network.
	  
config ONU_FE_RESPIN_RF400_ETH
	tristate "Onu FE network support for onu_respin"
	depends on ARCH_ONU
	help
	  This is a driver for the Opulan onu_resin FE network.
	  
config ATHEROS_SWITCH
	tristate "support ATHEROS network switch"
	depends on ONU_FE_ETH || ONU_FE_ETH_D2 ||ONU_FE_RESPIN_F23_ETH
	help
	  support ATHEROS network switch.
```

## os/linux-2.6.21.5/net/netfilter/nf_fastpath/Kconfig
```kconfig
config NF_CONNTRACK_FASTPATH
	tristate "Fast path based on NF Connection tracking (EXPERIMENTAL)"
	depends on NF_CONNTRACK && NF_CONNTRACK_IPV4 && IP_NF_IPTABLES
        select NF_CONNTRACK_EVENTS
        select NF_CONNTRACK_MARK

	help 
          If this option is enabled, the connection tracking code will
	  provide a data fastpath for TCP and UDP connections.  This
	  fastpath can bypass much of the normal packet processing in
	  Linux to significantly improve performance.  If unsure, say
	  'N'.  See Documentation/networking/nf_fastpath.txt for more 
          information.


config NF_FASTPATH_STATS
	bool "Fast path statistics"
        depends on NF_CONNTRACK_FASTPATH
        help
          Maintain statistics for the data fastpath.  This
          is generally only needed for debug purposes.  If unsure,
          say 'N';
```
